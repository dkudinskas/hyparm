## scripts/kconfig.data
```kconfig
menu "General setup"

choice
  prompt "Compiler optimization level"
  default OLEVEL_3

config OLEVEL_0
  bool "None (-O0)"

config OLEVEL_S
  bool "Size (-Os)"
  depends on !PREDICTABLE_DEBUGGING

config OLEVEL_1
  bool "Level 1 (-O1)"
  depends on !PREDICTABLE_DEBUGGING

config OLEVEL_2
  bool "Level 2 (-O2)"
  depends on !PREDICTABLE_DEBUGGING

config OLEVEL_3
  bool "Level 3 (-O3)"
  depends on !PREDICTABLE_DEBUGGING

config OLEVEL_FAST
  bool "Level fast (-Ofast)"
  depends on !PREDICTABLE_DEBUGGING

endchoice

config BUILD_ANALYZE_FUNCTIONS
  bool "Let the compiler suggest function attributes"
  depends on OLEVEL_3

config BUILD_SSP
  bool "Enable stack-smashing protector"
  depends on !PREDICTABLE_DEBUGGING

config BUILD_LTO
  bool "Link-time optimization (requires toolchain support)"
  depends on !PREDICTABLE_DEBUGGING

config BUILD_SAVE_TEMPS
  bool "Save intermediate files during build (requires GCC >= 4.5)"

config ASSERT
  bool "Enable run-time assertions"
  default y

choice
  prompt "Decoder"
  default DECODER_TABLE_SEARCH

config DECODER_AUTO
  bool "Auto-generated decoder"

config DECODER_TABLE_SEARCH
  bool "Handcrafted table search decoder"

endchoice

choice
  prompt "Memory allocator"
  default MEMORY_ALLOCATOR_NAIVE

config MEMORY_ALLOCATOR_NAIVE
  bool "Naive (no free)"

config MEMORY_ALLOCATOR_TLSF
  bool "TLSF"

endchoice

config PATH_AUTODECODER
  string "Path to autodecoder"

choice
  prompt "MMC/SD use"
  default NO_MMC

config NO_MMC
  bool "No SD/MMC access"

config MMC_GUEST_ACCESS
  bool "Give the guest access to the physical SD/MMC"
  
config MMC_LOG
  bool "Use MMC/SD device to store debug output"
  depends on DEBUG
endchoice

config PROFILER
  bool "Enable profiling"

endmenu

menu "Physical hardware platform"

config ARCH_V7
  bool

config ARCH_V7_A
  bool
  depends on ARCH_V7

config ARCH_EXT_SECURITY
  bool
  depends on ARCH_V7_A

config CPU_CORTEX_A8
  bool
  depends on ARCH_V7_A

config CPU_CORTEX_A9
  bool
  depends on ARCH_V7_A

config SOC_TI_OMAP_3
  bool
  depends on CPU_CORTEX_A8

config SOC_TI_OMAP_35XX
  bool
  depends on SOC_TI_OMAP_3

config SOC_TI_OMAP_3530
  bool
  depends on SOC_TI_OMAP_35XX

config SOC_TI_OMAP_4
  bool
  depends on CPU_CORTEX_A9

config SOC_TI_OMAP_4430
  bool
  depends on SOC_TI_OMAP_4

choice
  prompt "Board"
  default BOARD_TI_BEAGLE_BOARD

config BOARD_TI_BEAGLE_BOARD
  bool "Texas Instruments BeagleBoard"
  select ARCH_V7
  select ARCH_V7_A
  select ARCH_EXT_SECURITY
  select CPU_CORTEX_A8
  select SOC_TI_OMAP_3
  select SOC_TI_OMAP_35XX
  select SOC_TI_OMAP_3530

config BOARD_TI_PANDA_BOARD
  bool "Texas Instruments PandaBoard"
  select ARCH_V7
  select ARCH_V7_A
  select ARCH_EXT_SECURITY
  select CPU_CORTEX_A9
  select SOC_TI_OMAP_4
  select SOC_TI_OMAP_4430

endchoice

config UART_FAST
  bool "Fast UART (baud rate 500000)"
  depends on BOARD_TI_BEAGLE_BOARD

endmenu

menu "Virtual hardware platform"

config THUMB2
  bool "Thumb-2 instruction set"
  depends on ARCH_V7_A 

endmenu

menu "Guest software"

config GUEST_ANDROID
  bool "Android"

config GUEST_FREERTOS
  bool "FreeRTOS"

endmenu

menuconfig DEBUGGING_HACKS
  bool "Debugging hacks"
  default y

config PREDICTABLE_DEBUGGING
  bool "Maximize predictability for debugging"
  depends on DEBUGGING_HACKS
  select EMERGENCY_EXCEPTION_VECTOR if ARCH_EXT_SECURITY
  select SCANNER_EXTRA_CHECKS

config OCD_ROUTINES
  bool "Extra routines for JTAG debugging"
  default y
  depends on DEBUGGING_HACKS
  help
    Adds routines that can be used from within OpenOCD to safely dump hypervisor
    internals and alter processor state after a crash.

config BKPT
  bool "Software breakpoints for JTAG debugging (READ HELP)"
  depends on DEBUGGING_HACKS
  help
    Adds software breakpoints to the crash handler (DIE_NOW) and the emergency
    exception vector (if enabled).

    WARNING: Without the presence of a hardware debugger software breakpoints, when
    triggered, will cause prefetch aborts. Such aborts will cause the hypervisor to
    crash, trigger more software breakpoints, ... resulting in an infinite loop of
    prefetch aborts.

config DUMP_STACK
  bool "Dump stack on crash"
  depends on DEBUGGING_HACKS

config EMERGENCY_EXCEPTION_VECTOR
  bool "Emergency exception vector"
  default y
  depends on ARCH_EXT_SECURITY && DEBUGGING_HACKS

config CONTEXT_SWITCH_COUNTERS
  bool "Count number of hypercalls, data aborts, irqs and their causes"
  depends on DEBUGGING_HACKS

config SCANNER_COUNT_BLOCKS
  bool "Count number of scanned blocks"
  depends on DEBUGGING_HACKS

config SCANNER_EXTRA_CHECKS
  bool "Track call source and check for null pointers in scanner"
  depends on DEBUGGING_HACKS

config SCANNER_STATISTICS
  bool "Collect block size statistics in scanner"
  depends on DEBUGGING_HACKS && !THUMB2

config SCANNER_STATISTICS_BIG_BLOCK_TRESHOLD
  int "Big block treshold"
  default 80
  range 1 999
  depends on DEBUGGING_HACKS && SCANNER_STATISTICS

config GUEST_CONTEXT_BLOCK_TRACE
  bool "Store block trace in guest context"
  default y
  depends on DEBUGGING_HACKS

config GUEST_CONTEXT_BLOCK_TRACE_SIZE
  int "Number of blocks"
  default 6
  range 1 100 if !LOOP_DETECTOR
  range 4 100 if LOOP_DETECTOR
  depends on DEBUGGING_HACKS && GUEST_CONTEXT_BLOCK_TRACE

config LOOP_DETECTOR
  bool "Detect single block loops in privileged guest code"
  depends on DEBUGGING_HACKS && GUEST_CONTEXT_BLOCK_TRACE

config LOOP_DETECTOR_WARN_TRESHOLD
  int "Minimum number of iterations that causes a warning"
  default 262144
  range 2 134217728
  depends on DEBUGGING_HACKS && LOOP_DETECTOR

config LOOP_DETECTOR_DIE_TRESHOLD
  int "Number of iterations that causes the hypervisor to die"
  default 524288
  range 2 134217728
  depends on DEBUGGING_HACKS && LOOP_DETECTOR

config BLOCK_CACHE_COLLISION_COUNTER
  bool "Count number of collisions in block cache"
  depends on DEBUGGING_HACKS

config MEMORY_ALLOCATOR_BOOKKEEPING
  bool "Extensive memory allocator bookkeeping"
  depends on DEBUGGING_HACKS

config SDRAM_STORE_COUNTER
  bool "SDRAM store counter"
  default y
  depends on DEBUGGING_HACKS

menuconfig DEBUG
  bool "Debug output"
  default y
  help
    Disabling this option does not prevent generation of debug symbols and dump.
    It merely disables all the individual debug output options at once.

config DEBUG_STARTUP
  bool "Debug startup"
  depends on DEBUG

config DEBUG_GUEST_CONTEXT
  bool "Debug guest context routines"
  default y
  depends on DEBUG

config DEBUG_MEMORY_ALLOCATOR
  bool "Debug memory allocator"
  depends on DEBUG

config DEBUG_MEMORY_ALLOCATOR_BOOKKEEPING
  bool "Debug memory allocator bookkeeping"
  depends on DEBUG && MEMORY_ALLOCATOR_BOOKKEEPING

config DEBUG_MEMORY_MANAGER
  bool "Debug memory manager"
  default n
  depends on DEBUG

config DEBUG_MM_ADDRESSING
  bool "Debug addressing"
  default n
  depends on DEBUG_MEMORY_MANAGER

config DEBUG_MM_MMU
  bool "Debug MMU operations"
  default n
  depends on DEBUG_MEMORY_MANAGER

config DEBUG_MM_PAGE_TABLES
  bool "Debug low-level page table operations"
  default n
  depends on DEBUG_MEMORY_MANAGER

config DEBUG_MM_SHADOWING
  bool "Debug shadow mapping"
  default n
  depends on DEBUG_MEMORY_MANAGER

config DEBUG_EXCEPTION_HANDLERS
  bool "Debug exception handlers"
  depends on DEBUG

config DEBUG_EXCEPTION_HANDLERS_TRACE_DABT
  bool "Trace data aborts"
  depends on DEBUG

config DEBUG_GUEST_EXCEPTIONS
  bool "Debug guest exceptions"
  depends on DEBUG

config DEBUG_DECODER
  bool "Debug instruction decoding"
  depends on DEBUG

config DEBUG_SCANNER
  bool "Debug scanner"
  depends on DEBUG

config DEBUG_SCANNER_BLOCK_TRACE
  bool "Print block trace"
  depends on DEBUG_SCANNER

config DEBUG_SCANNER_MARK
  bool "Regularly print a mark message"
  depends on DEBUG_SCANNER
  select SCANNER_COUNT_BLOCKS

config DEBUG_SCANNER_MARK_INTERVAL
  int "Mark every 2^n blocks"
  range 18 31
  default 19
  depends on DEBUG_SCANNER_MARK

config DEBUG_SCANNER_EXTRA
  bool "Extra debug messages"
  depends on DEBUG_SCANNER

config DEBUG_TRANSLATION
  bool "Debug translation"
  depends on DEBUG

config DEBUG_BLOCK_STORE
  bool "Debug block store"
  depends on DEBUG

config DEBUG_TRANSLATION_STORE
  bool "Debug translation store"
  depends on DEBUG

config DEBUG_INTERPRETER
  bool "Debug interpreter"
  depends on DEBUG

menuconfig DEBUG_INTERPRETER_ALL
  bool "Debug interpreter for all instruction sets"
  depends on DEBUG_INTERPRETER
  select DEBUG_INTERPRETER_ARM
  select DEBUG_INTERPRETER_T16
  select DEBUG_INTERPRETER_T32

config DEBUG_INTERPRETER_ALL_BRANCH
  bool "Debug branch operations"
  depends on DEBUG_INTERPRETER_ALL
  select DEBUG_INTERPRETER_ARM_BRANCH
  select DEBUG_INTERPRETER_T16_BRANCH
  select DEBUG_INTERPRETER_T32_BRANCH

config DEBUG_INTERPRETER_ALL_COPROC
  bool "Debug coprocessor operations"
  depends on DEBUG_INTERPRETER_ALL
  select DEBUG_INTERPRETER_ANY_COPROC
  select DEBUG_INTERPRETER_ARM_COPROC
  select DEBUG_INTERPRETER_T32_COPROC

config DEBUG_INTERPRETER_ALL_LOAD
  bool "Debug load operations"
  depends on DEBUG_INTERPRETER_ALL
  select DEBUG_INTERPRETER_ARM_LOAD
  select DEBUG_INTERPRETER_ARM_LOAD_SYNC
  select DEBUG_INTERPRETER_T16_LOAD
  select DEBUG_INTERPRETER_T32_LOAD

config DEBUG_INTERPRETER_ALL_STORE
  bool "Debug store operations"
  depends on DEBUG_INTERPRETER_ALL
  select DEBUG_INTERPRETER_ARM_STORE
  select DEBUG_INTERPRETER_ARM_STORE_SYNC
  select DEBUG_INTERPRETER_T16_STORE
  select DEBUG_INTERPRETER_T32_STORE

config DEBUG_INTERPRETER_ALL_SYNC
  bool "Debug synchronization operations"
  depends on DEBUG_INTERPRETER_ALL
  select DEBUG_INTERPRETER_ARM_LOAD_SYNC
  select DEBUG_INTERPRETER_ARM_STORE_SYNC
  select DEBUG_INTERPRETER_ARM_SYNC

menuconfig DEBUG_INTERPRETER_ARM
  bool "Debug ARM interpreter"
  depends on DEBUG_INTERPRETER

config DEBUG_INTERPRETER_ARM_BRANCH
  bool "Debug branch operations"
  depends on DEBUG_INTERPRETER_ARM

config DEBUG_INTERPRETER_ARM_COPROC
  bool "Debug coprocessor operations"
  depends on DEBUG_INTERPRETER_ARM
  select DEBUG_INTERPRETER_ANY_COPROC

config DEBUG_INTERPRETER_ARM_LOAD
  bool "Debug load operations"
  depends on DEBUG_INTERPRETER_ARM
  select DEBUG_INTERPRETER_ARM_LOAD_SYNC

config DEBUG_INTERPRETER_ARM_LOAD_SYNC
  bool
  depends on DEBUG_INTERPRETER_ARM

config DEBUG_INTERPRETER_ARM_STORE
  bool "Debug store operations"
  depends on DEBUG_INTERPRETER_ARM
  select DEBUG_INTERPRETER_ARM_STORE_SYNC

config DEBUG_INTERPRETER_ARM_STORE_SYNC
  bool
  depends on DEBUG_INTERPRETER_ARM

config DEBUG_INTERPRETER_ARM_SYNC
  bool "Debug synchronization operations"
  depends on DEBUG_INTERPRETER_ARM
  select DEBUG_INTERPRETER_ARM_LOAD_SYNC
  select DEBUG_INTERPRETER_ARM_STORE_SYNC

menuconfig DEBUG_INTERPRETER_T16
  bool "Debug Thumb 16-bit interpreter"
  depends on DEBUG_INTERPRETER

config DEBUG_INTERPRETER_T16_BRANCH
  bool "Debug branch operations"
  depends on DEBUG_INTERPRETER_T16

config DEBUG_INTERPRETER_T16_LOAD
  bool "Debug load operations"
  depends on DEBUG_INTERPRETER_T16

config DEBUG_INTERPRETER_T16_STORE
  bool "Debug store operations"
  depends on DEBUG_INTERPRETER_T16

menuconfig DEBUG_INTERPRETER_T32
  bool "Debug Thumb 32-bit interpreter"
  depends on DEBUG_INTERPRETER

config DEBUG_INTERPRETER_T32_BRANCH
  bool "Debug branch operations"
  depends on DEBUG_INTERPRETER_T32

config DEBUG_INTERPRETER_T32_COPROC
  bool "Debug coprocessor operations"
  depends on DEBUG_INTERPRETER_T32
  select DEBUG_INTERPRETER_ANY_COPROC

config DEBUG_INTERPRETER_T32_LOAD
  bool "Debug load operations"
  depends on DEBUG_INTERPRETER_T32

config DEBUG_INTERPRETER_T32_STORE
  bool "Debug store operations"
  depends on DEBUG_INTERPRETER_T32

menuconfig DEBUG_PHYSICAL_PLATFORM
  bool "Debug physical hardware platform (drivers)"
  depends on DEBUG

config DEBUG_PP_OMAP_35XX_TIMER32K
  bool "Debug 32 kHz timer (TIMER32K)"
  depends on DEBUG_PHYSICAL_PLATFORM

config DEBUG_PP_OMAP_35XX_CM
  bool "Debug clock manager (CM)"
  depends on DEBUG_PHYSICAL_PLATFORM

config DEBUG_PP_OMAP_35XX_GPTIMER
  bool "Debug general purpose timers (GPTIMER)"
  depends on DEBUG_PHYSICAL_PLATFORM

config DEBUG_PP_OMAP_35XX_INTC
  bool "Debug interrupt controller (INTC)"
  depends on DEBUG_PHYSICAL_PLATFORM

config DEBUG_PP_OMAP_35XX_MMCHS
  bool "Debug MMC host controller (MMCHS)"
  depends on DEBUG_PHYSICAL_PLATFORM

config DEBUG_PP_OMAP_35XX_UART
  bool "Debug UART"
  depends on DEBUG_PHYSICAL_PLATFORM

menuconfig DEBUG_VIRTUAL_PLATFORM
  bool "Debug virtual hardware platform (emulation)"
  depends on DEBUG

config DEBUG_VP_OMAP_35XX_LIBRARY
  bool "Debug device library"
  depends on DEBUG_VIRTUAL_PLATFORM

config DEBUG_VP_OMAP_35XX_TIMER32K
  bool "Debug 32 kHz timer (TIMER32K)"
  depends on DEBUG_VIRTUAL_PLATFORM

config DEBUG_VP_OMAP_35XX_CM
  bool "Debug clock manager (CM)"
  depends on DEBUG_VIRTUAL_PLATFORM

config DEBUG_VP_OMAP_35XX_GPIO
  bool "Debug GPIO"
  depends on DEBUG_VIRTUAL_PLATFORM

config DEBUG_VP_OMAP_35XX_GPTIMER
  bool "Debug general purpose timers (GPTIMER)"
  depends on DEBUG_VIRTUAL_PLATFORM

config DEBUG_VP_OMAP_35XX_INTC
  bool "Debug interrupt controller (INTC)"
  depends on DEBUG_VIRTUAL_PLATFORM

config DEBUG_VP_OMAP_35XX_GPMC
  bool "Debug memory controller (GPMC)"
  depends on DEBUG_VIRTUAL_PLATFORM

config DEBUG_VP_OMAP_35XX_I2C
  bool "Debug I2C controller"
  depends on DEBUG_VIRTUAL_PLATFORM

config DEBUG_VP_OMAP_35XX_TWL4030
  bool "Debug power management chip (TWL4030)"
  depends on DEBUG_VIRTUAL_PLATFORM

config DEBUG_VP_OMAP_35XX_MMC
  bool "Debug MMC"
  depends on DEBUG_VIRTUAL_PLATFORM
  
config DEBUG_VP_OMAP_35XX_PM
  bool "Debug L3 protection mechanism (PM)"
  depends on DEBUG_VIRTUAL_PLATFORM
  
config DEBUG_VP_OMAP_35XX_PRM
  bool "Debug power and reset manager (PRM)"
  depends on DEBUG_VIRTUAL_PLATFORM

config DEBUG_VP_OMAP_35XX_SCM
  bool "Debug system control module (SCM)"
  depends on DEBUG_VIRTUAL_PLATFORM

config DEBUG_VP_OMAP_35XX_SDMA
  bool "Debug SDMA"
  depends on DEBUG_VIRTUAL_PLATFORM

config DEBUG_VP_OMAP_35XX_SDRAM
  bool "Debug SDRAM"
  depends on DEBUG_VIRTUAL_PLATFORM
  
config DEBUG_VP_OMAP_35XX_SDRC
  bool "Debug SDRAM Controller (SDRC)"
  depends on DEBUG_VIRTUAL_PLATFORM

config DEBUG_VP_OMAP_35XX_SMS
  bool "Debug SDRAM Memory Scheduler (SMS)"
  depends on DEBUG_VIRTUAL_PLATFORM

config DEBUG_VP_OMAP_35XX_SRAM
  bool "Debug SRAM"
  depends on DEBUG_VIRTUAL_PLATFORM

config DEBUG_VP_OMAP_35XX_UART
  bool "Debug UART"
  depends on DEBUG_VIRTUAL_PLATFORM

config DEBUG_VP_OMAP_35XX_WDTIMER
  bool "Debug watchdog timers (WDTIMER)"
  depends on DEBUG_VIRTUAL_PLATFORM

config DEBUG_MMC
  bool "Debug MMC block device"
  depends on (DEBUG && (!NO_MMC))

config DEBUG_PARTITIONS
  bool "Debug partition detection"
  depends on (DEBUG && MMC_LOG)

config DEBUG_FS_FAT
  bool "Debug FAT file system"
  depends on (DEBUG && MMC_LOG)

config DEBUG_INTERPRETER_ANY_COPROC
  bool

menu "Miscellaneous hacks"

config CLI
  bool "Command-line interface"

config DISABLE_HYPERVISOR_MEMORY_PROTECTION
  bool "Disable hypervisor memory protection"

endmenu
```
